/begin CHARACTERISTIC Cal_A_Tar_Decel_Mu_Hi "" VALUE 0x70028e02 __UWORD_S 0 NO_COMPU_METHOD -2147483648 2147483647 FORMAT "%.15" /end CHARACTERISTIC
/begin CHARACTERISTIC Cal_A_Tar_Decel_Mu_Lo "" VALUE 0x70028e04 __UWORD_S 0 NO_COMPU_METHOD -2147483648 2147483647 FORMAT "%.15" /end CHARACTERISTIC
/begin CHARACTERISTIC Cal_A_Thd_Hill_Det_Fast "" VALUE 0x70028e06 __UWORD_S 0 NO_COMPU_METHOD -2147483648 2147483647 FORMAT "%.15" /end CHARACTERISTIC
/begin CHARACTERISTIC Cal_A_Thd_Hill_Det_Slow "" VALUE 0x70028e08 __UWORD_S 0 NO_COMPU_METHOD -2147483648 2147483647 FORMAT "%.15" /end CHARACTERISTIC
/begin CHARACTERISTIC Cal_C_Mot_Cfm_Cls_Max "" VALUE 0x70028e0a __UWORD_S 0 NO_COMPU_METHOD -2147483648 2147483647 FORMAT "%.15" /end CHARACTERISTIC
/begin CHARACTERISTIC Cal_Grdt_Thd_Hill0 "" VALUE 0x70028e0c __UWORD_S 0 NO_COMPU_METHOD -2147483648 2147483647 FORMAT "%.15" /end CHARACTERISTIC
/begin CHARACTERISTIC Cal_Grdt_Thd_Hill1 "" VALUE 0x70028e0e __UWORD_S 0 NO_COMPU_METHOD -2147483648 2147483647 FORMAT "%.15" /end CHARACTERISTIC
/begin CHARACTERISTIC Cal_Grdt_Thd_Hill2 "" VALUE 0x70028e10 __UWORD_S 0 NO_COMPU_METHOD -2147483648 2147483647 FORMAT "%.15" /end CHARACTERISTIC
/begin CHARACTERISTIC Cal_I_Cfm_Stuck "" VALUE 0x70028e12 __UWORD_S 0 NO_COMPU_METHOD -2147483648 2147483647 FORMAT "%.15" /end CHARACTERISTIC
/begin CHARACTERISTIC Cal_I_Delta_Stuck_Coulomb_Clr_Suspt "" VALUE 0x70028e14 __UWORD_S 0 NO_COMPU_METHOD -2147483648 2147483647 FORMAT "%.15" /end CHARACTERISTIC
/begin CHARACTERISTIC Cal_I_Delta_Stuck_Suspt_10 "" VALUE 0x70028e16 __UWORD_S 0 NO_COMPU_METHOD -2147483648 2147483647 FORMAT "%.15" /end CHARACTERISTIC
/begin CHARACTERISTIC Cal_I_Delta_Stuck_Suspt_20 "" VALUE 0x70028e18 __UWORD_S 0 NO_COMPU_METHOD -2147483648 2147483647 FORMAT "%.15" /end CHARACTERISTIC
/begin CHARACTERISTIC Cal_I_Mot_Stuck_Clr_Suspt "" VALUE 0x70028e1a __UWORD_S 0 NO_COMPU_METHOD -2147483648 2147483647 FORMAT "%.15" /end CHARACTERISTIC
/begin CHARACTERISTIC Cal_I_Suspt_Ovload_Err "" VALUE 0x70028e1c __UWORD_S 0 NO_COMPU_METHOD -2147483648 2147483647 FORMAT "%.15" /end CHARACTERISTIC
/begin CHARACTERISTIC Cal_I_Tar_AdpvBrk0 "" VALUE 0x70028e1e __UWORD_S 0 NO_COMPU_METHOD -2147483648 2147483647 FORMAT "%.15" /end CHARACTERISTIC
/begin CHARACTERISTIC Cal_I_Tar_AdpvBrk1 "" VALUE 0x70028e20 __UWORD_S 0 NO_COMPU_METHOD -2147483648 2147483647 FORMAT "%.15" /end CHARACTERISTIC
/begin CHARACTERISTIC Cal_I_Tar_ClsBrk "" VALUE 0x70028e22 __UWORD_S 0 NO_COMPU_METHOD -2147483648 2147483647 FORMAT "%.15" /end CHARACTERISTIC
/begin CHARACTERISTIC Cal_I_Tar_CmplyOpen "" VALUE 0x70028e24 __UWORD_S 0 NO_COMPU_METHOD -2147483648 2147483647 FORMAT "%.15" /end CHARACTERISTIC
/begin CHARACTERISTIC Cal_I_Tar_Delta_CmplyOpen "" VALUE 0x70028e26 __UWORD_S 0 NO_COMPU_METHOD -2147483648 2147483647 FORMAT "%.15" /end CHARACTERISTIC
/begin CHARACTERISTIC Cal_I_Tar_Delta_TchBrk "" VALUE 0x70028e28 __UWORD_S 0 NO_COMPU_METHOD -2147483648 2147483647 FORMAT "%.15" /end CHARACTERISTIC
/begin CHARACTERISTIC Cal_I_Tar_HldBrk "" VALUE 0x70028e2a __UWORD_S 0 NO_COMPU_METHOD -2147483648 2147483647 FORMAT "%.15" /end CHARACTERISTIC
/begin CHARACTERISTIC Cal_I_Tar_ReClsBrk_HTR "" VALUE 0x70028e2c __UWORD_S 0 NO_COMPU_METHOD -2147483648 2147483647 FORMAT "%.15" /end CHARACTERISTIC
/begin CHARACTERISTIC Cal_I_Tar_ReClsBrk_RAR "" VALUE 0x70028e2e __UWORD_S 0 NO_COMPU_METHOD -2147483648 2147483647 FORMAT "%.15" /end CHARACTERISTIC
/begin CHARACTERISTIC Cal_I_Thd_Cfm_Noload_Entry "" VALUE 0x70028e30 __UWORD_S 0 NO_COMPU_METHOD -2147483648 2147483647 FORMAT "%.15" /end CHARACTERISTIC
/begin CHARACTERISTIC Cal_I_Thd_Cfm_Noload_Entry_Min "" VALUE 0x70028e32 __UWORD_S 0 NO_COMPU_METHOD -2147483648 2147483647 FORMAT "%.15" /end CHARACTERISTIC
/begin CHARACTERISTIC Cal_I_Thd_Noload_Stab_Max "" VALUE 0x70028e34 __UWORD_S 0 NO_COMPU_METHOD -2147483648 2147483647 FORMAT "%.15" /end CHARACTERISTIC
/begin CHARACTERISTIC Cal_I_Thd_Noload_Stab_Max2 "" VALUE 0x70028e36 __UWORD_S 0 NO_COMPU_METHOD -2147483648 2147483647 FORMAT "%.15" /end CHARACTERISTIC
/begin CHARACTERISTIC Cal_I_Tolr_Stuck_Cfm "" VALUE 0x70028e38 __UWORD_S 0 NO_COMPU_METHOD -2147483648 2147483647 FORMAT "%.15" /end CHARACTERISTIC
/begin CHARACTERISTIC Cal_LgtA_Intl_Thd_Rock "" VALUE 0x70028e3a __UWORD_S 0 NO_COMPU_METHOD -2147483648 2147483647 FORMAT "%.15" /end CHARACTERISTIC
/begin CHARACTERISTIC Cal_Milg_Thd_PAD "" VALUE 0x70028e3c __UWORD_S 0 NO_COMPU_METHOD -2147483648 2147483647 FORMAT "%.15" /end CHARACTERISTIC
/begin CHARACTERISTIC Cal_Nr_I_Mot_Buf "" VALUE 0x70028e3e __UWORD_S 0 NO_COMPU_METHOD -2147483648 2147483647 FORMAT "%.15" /end CHARACTERISTIC
/begin CHARACTERISTIC Cal_Nr_Oper_RollrStepCls_Max "" VALUE 0x70028e40 __UWORD_S 0 NO_COMPU_METHOD -2147483648 2147483647 FORMAT "%.15" /end CHARACTERISTIC
/begin CHARACTERISTIC Cal_Nr_Retry_HostAvl_Max "" VALUE 0x70028e42 __UWORD_S 0 NO_COMPU_METHOD -2147483648 2147483647 FORMAT "%.15" /end CHARACTERISTIC
/begin CHARACTERISTIC Cal_Nr_Retry_RAR_Max "" VALUE 0x70028e43 __UWORD_S 0 NO_COMPU_METHOD -2147483648 2147483647 FORMAT "%.15" /end CHARACTERISTIC
/begin CHARACTERISTIC Cal_Nr_Thd_Pls_Rollg_Fast "" VALUE 0x70028e44 __UWORD_S 0 NO_COMPU_METHOD -2147483648 2147483647 FORMAT "%.15" /end CHARACTERISTIC
/begin CHARACTERISTIC Cal_Nr_Thd_Pls_Rollg_Slow "" VALUE 0x70028e46 __UWORD_S 0 NO_COMPU_METHOD -2147483648 2147483647 FORMAT "%.15" /end CHARACTERISTIC
/begin CHARACTERISTIC Cal_P_Thd_Wheel0 "" VALUE 0x70028e48 __UWORD_S 0 NO_COMPU_METHOD -2147483648 2147483647 FORMAT "%.15" /end CHARACTERISTIC
/begin CHARACTERISTIC Cal_P_Thd_Wheel1 "" VALUE 0x70028e4a __UWORD_S 0 NO_COMPU_METHOD -2147483648 2147483647 FORMAT "%.15" /end CHARACTERISTIC
/begin CHARACTERISTIC Cal_Rat_Absrp_Heat "" VALUE 0x70028e4c __UWORD_S 0 NO_COMPU_METHOD -2147483648 2147483647 FORMAT "%.15" /end CHARACTERISTIC
/begin CHARACTERISTIC Cal_Rat_Cnvc_Cool_Dyn "" VALUE 0x70028e4e __UWORD_S 0 NO_COMPU_METHOD -2147483648 2147483647 FORMAT "%.15" /end CHARACTERISTIC
/begin CHARACTERISTIC Cal_Rat_Cnvc_Cool_Stat "" VALUE 0x70028e50 __UWORD_S 0 NO_COMPU_METHOD -2147483648 2147483647 FORMAT "%.15" /end CHARACTERISTIC
/begin CHARACTERISTIC Cal_Rat_Rad_Cool "" VALUE 0x70028e52 __UWORD_S 0 NO_COMPU_METHOD -2147483648 2147483647 FORMAT "%.15" /end CHARACTERISTIC
/begin CHARACTERISTIC Cal_Spd_Diff_Limit "" VALUE 0x70028e54 __UWORD_S 0 NO_COMPU_METHOD -2147483648 2147483647 FORMAT "%.15" /end CHARACTERISTIC
/begin CHARACTERISTIC Cal_Spd_Thd_Slip_Mu_Lo "" VALUE 0x70028e56 __UWORD_S 0 NO_COMPU_METHOD -2147483648 2147483647 FORMAT "%.15" /end CHARACTERISTIC
/begin CHARACTERISTIC Cal_Spd_Thd_VehSt_Cfm_Stat "" VALUE 0x70028e58 __UWORD_S 0 NO_COMPU_METHOD -2147483648 2147483647 FORMAT "%.15" /end CHARACTERISTIC
/begin CHARACTERISTIC Cal_Spd_Tolr_Slip_Max "" VALUE 0x70028e5a __UWORD_S 0 NO_COMPU_METHOD -2147483648 2147483647 FORMAT "%.15" /end CHARACTERISTIC
/begin CHARACTERISTIC Cal_Spd_Tolr_Slip_Min "" VALUE 0x70028e5c __UWORD_S 0 NO_COMPU_METHOD -2147483648 2147483647 FORMAT "%.15" /end CHARACTERISTIC
/begin CHARACTERISTIC Cal_T_Delta_Reclmp "" VALUE 0x70028e5e __UWORD_S 0 NO_COMPU_METHOD -2147483648 2147483647 FORMAT "%.15" /end CHARACTERISTIC
/begin CHARACTERISTIC Cal_T_Thd_Dsc0 "" VALUE 0x70028e60 __UWORD_S 0 NO_COMPU_METHOD -2147483648 2147483647 FORMAT "%.15" /end CHARACTERISTIC
/begin CHARACTERISTIC Cal_T_Thd_Dsc_Oper_Max "" VALUE 0x70028e62 __UWORD_S 0 NO_COMPU_METHOD -2147483648 2147483647 FORMAT "%.15" /end CHARACTERISTIC
/begin CHARACTERISTIC Cal_T_Thd_Dsc_Worst "" VALUE 0x70028e64 __UWORD_S 0 NO_COMPU_METHOD -2147483648 2147483647 FORMAT "%.15" /end CHARACTERISTIC
/begin CHARACTERISTIC Cal_Ti_Ahd_Estimn_Slip "" VALUE 0x70028e66 __UWORD_S 0 NO_COMPU_METHOD -2147483648 2147483647 FORMAT "%.15" /end CHARACTERISTIC
/begin CHARACTERISTIC Cal_Ti_Cfm_CmplyRelease_Entry "" VALUE 0x70028e68 __UWORD_S 0 NO_COMPU_METHOD -2147483648 2147483647 FORMAT "%.15" /end CHARACTERISTIC
/begin CHARACTERISTIC Cal_Ti_CmpU_Sply0 "" VALUE 0x70028e6a __UWORD_S 0 NO_COMPU_METHOD -2147483648 2147483647 FORMAT "%.15" /end CHARACTERISTIC
/begin CHARACTERISTIC Cal_Ti_CmpU_Sply1 "" VALUE 0x70028e6c __UWORD_S 0 NO_COMPU_METHOD -2147483648 2147483647 FORMAT "%.15" /end CHARACTERISTIC
/begin CHARACTERISTIC Cal_Ti_CmpU_Sply2 "" VALUE 0x70028e6e __UWORD_S 0 NO_COMPU_METHOD -2147483648 2147483647 FORMAT "%.15" /end CHARACTERISTIC
/begin CHARACTERISTIC Cal_Ti_CmpU_Sply5 "" VALUE 0x70028e70 __UWORD_S 0 NO_COMPU_METHOD -2147483648 2147483647 FORMAT "%.15" /end CHARACTERISTIC
/begin CHARACTERISTIC Cal_Ti_CmpU_Sply6 "" VALUE 0x70028e72 __UWORD_S 0 NO_COMPU_METHOD -2147483648 2147483647 FORMAT "%.15" /end CHARACTERISTIC
/begin CHARACTERISTIC Cal_Ti_Dyn_Apply_Limit_Lo_Spd "" VALUE 0x70028e74 __UWORD_S 0 NO_COMPU_METHOD -2147483648 2147483647 FORMAT "%.15" /end CHARACTERISTIC
/begin CHARACTERISTIC Cal_Ti_Dyn_Release_Limit_Lo_Spd "" VALUE 0x70028e76 __UWORD_S 0 NO_COMPU_METHOD -2147483648 2147483647 FORMAT "%.15" /end CHARACTERISTIC
/begin CHARACTERISTIC Cal_Ti_Inhibit_DAR "" VALUE 0x70028e78 __UWORD_S 0 NO_COMPU_METHOD -2147483648 2147483647 FORMAT "%.15" /end CHARACTERISTIC
/begin CHARACTERISTIC Cal_Ti_Intl_Calcn_Whl_Decel "" VALUE 0x70028e7a __UWORD_S 0 NO_COMPU_METHOD -2147483648 2147483647 FORMAT "%.15" /end CHARACTERISTIC
/begin CHARACTERISTIC Cal_Ti_Intl_Cfm_CmplyOpen_Min "" VALUE 0x70028e7c __UWORD_S 0 NO_COMPU_METHOD -2147483648 2147483647 FORMAT "%.15" /end CHARACTERISTIC
/begin CHARACTERISTIC Cal_Ti_Intl_Cfm_LgtA_Stab "" VALUE 0x70028e7e __UWORD_S 0 NO_COMPU_METHOD -2147483648 2147483647 FORMAT "%.15" /end CHARACTERISTIC
/begin CHARACTERISTIC Cal_Ti_Intl_Cfm_Noload_Entry "" VALUE 0x70028e80 __UWORD_S 0 NO_COMPU_METHOD -2147483648 2147483647 FORMAT "%.15" /end CHARACTERISTIC
/begin CHARACTERISTIC Cal_Ti_Intl_Cfm_Ovload "" VALUE 0x70028e82 __UWORD_S 0 NO_COMPU_METHOD -2147483648 2147483647 FORMAT "%.15" /end CHARACTERISTIC
/begin CHARACTERISTIC Cal_Ti_Intl_Cfm_Ovrun "" VALUE 0x70028e84 __UWORD_S 0 NO_COMPU_METHOD -2147483648 2147483647 FORMAT "%.15" /end CHARACTERISTIC
/begin CHARACTERISTIC Cal_Ti_Intl_Cfm_Retry_ClsBrk "" VALUE 0x70028e86 __UWORD_S 0 NO_COMPU_METHOD -2147483648 2147483647 FORMAT "%.15" /end CHARACTERISTIC
/begin CHARACTERISTIC Cal_Ti_Intl_Cfm_Stuck_Cls "" VALUE 0x70028e88 __UWORD_S 0 NO_COMPU_METHOD -2147483648 2147483647 FORMAT "%.15" /end CHARACTERISTIC
/begin CHARACTERISTIC Cal_Ti_Intl_Cfm_Stuck_Open "" VALUE 0x70028e8a __UWORD_S 0 NO_COMPU_METHOD -2147483648 2147483647 FORMAT "%.15" /end CHARACTERISTIC
/begin CHARACTERISTIC Cal_Ti_Intl_Decel_Inc "" VALUE 0x70028e8c __UWORD_S 0 NO_COMPU_METHOD -2147483648 2147483647 FORMAT "%.15" /end CHARACTERISTIC
/begin CHARACTERISTIC Cal_Ti_Intl_Inrush_Max "" VALUE 0x70028e8e __UWORD_S 0 NO_COMPU_METHOD -2147483648 2147483647 FORMAT "%.15" /end CHARACTERISTIC
/begin CHARACTERISTIC Cal_Ti_Intl_Load_Entry_Min "" VALUE 0x70028e90 __UWORD_S 0 NO_COMPU_METHOD -2147483648 2147483647 FORMAT "%.15" /end CHARACTERISTIC
/begin CHARACTERISTIC Cal_Ti_Intl_Mon_Rollg_Fast "" VALUE 0x70028e92 __UWORD_S 0 NO_COMPU_METHOD -2147483648 2147483647 FORMAT "%.15" /end CHARACTERISTIC
/begin CHARACTERISTIC Cal_Ti_Intl_Mon_Rollg_Slow "" VALUE 0x70028e94 __UWORD_S 0 NO_COMPU_METHOD -2147483648 2147483647 FORMAT "%.15" /end CHARACTERISTIC
/begin CHARACTERISTIC Cal_Ti_Intl_SRU "" VALUE 0x70028e96 __UWORD_S 0 NO_COMPU_METHOD -2147483648 2147483647 FORMAT "%.15" /end CHARACTERISTIC
/begin CHARACTERISTIC Cal_Ti_Intl_Trig_Rollr_Max "" VALUE 0x70028e98 __UWORD_S 0 NO_COMPU_METHOD -2147483648 2147483647 FORMAT "%.15" /end CHARACTERISTIC
/begin CHARACTERISTIC Cal_Ti_Op_Reclmp_Min "" VALUE 0x70028e9a __UWORD_S 0 NO_COMPU_METHOD -2147483648 2147483647 FORMAT "%.15" /end CHARACTERISTIC
/begin CHARACTERISTIC Cal_Ti_Posn_Cnt_Dyn_Max "" VALUE 0x70028e9c __UWORD_S 0 NO_COMPU_METHOD -2147483648 2147483647 FORMAT "%.15" /end CHARACTERISTIC
/begin CHARACTERISTIC Cal_Ti_Posn_Cnt_Dyn_Min "" VALUE 0x70028e9e __UWORD_S 0 NO_COMPU_METHOD -2147483648 2147483647 FORMAT "%.15" /end CHARACTERISTIC
/begin CHARACTERISTIC Cal_Ti_Posn_Cnt_Offs_TchBrkd "" VALUE 0x70028ea0 __UWORD_S 0 NO_COMPU_METHOD -2147483648 2147483647 FORMAT "%.15" /end CHARACTERISTIC
/begin CHARACTERISTIC Cal_Ti_Posn_Cnt_Tar_Dyn_Dgrd2 "" VALUE 0x70028ea2 __UWORD_S 0 NO_COMPU_METHOD -2147483648 2147483647 FORMAT "%.15" /end CHARACTERISTIC
/begin CHARACTERISTIC Cal_Ti_Posn_Cnt_Tar_Dyn_Dgrd3 "" VALUE 0x70028ea4 __UWORD_S 0 NO_COMPU_METHOD -2147483648 2147483647 FORMAT "%.15" /end CHARACTERISTIC
/begin CHARACTERISTIC Cal_Ti_Reclmp_Inhibit "" VALUE 0x70028ea6 __UWORD_S 0 NO_COMPU_METHOD -2147483648 2147483647 FORMAT "%.15" /end CHARACTERISTIC
/begin CHARACTERISTIC Cal_Ti_Tar_Ltch0 "" VALUE 0x70028ea8 __UWORD_S 0 NO_COMPU_METHOD -2147483648 2147483647 FORMAT "%.15" /end CHARACTERISTIC
/begin CHARACTERISTIC Cal_Ti_Tar_Ltch1 "" VALUE 0x70028eaa __UWORD_S 0 NO_COMPU_METHOD -2147483648 2147483647 FORMAT "%.15" /end CHARACTERISTIC
/begin CHARACTERISTIC Cal_Ti_Tar_Ltch2 "" VALUE 0x70028eac __UWORD_S 0 NO_COMPU_METHOD -2147483648 2147483647 FORMAT "%.15" /end CHARACTERISTIC
/begin CHARACTERISTIC Cal_Ti_Tar_Ltch3 "" VALUE 0x70028eae __UWORD_S 0 NO_COMPU_METHOD -2147483648 2147483647 FORMAT "%.15" /end CHARACTERISTIC
/begin CHARACTERISTIC Cal_Ti_Tar_Ltch4 "" VALUE 0x70028eb0 __UWORD_S 0 NO_COMPU_METHOD -2147483648 2147483647 FORMAT "%.15" /end CHARACTERISTIC
/begin CHARACTERISTIC Cal_Ti_Tar_OneTiOpen "" VALUE 0x70028eb2 __UWORD_S 0 NO_COMPU_METHOD -2147483648 2147483647 FORMAT "%.15" /end CHARACTERISTIC
/begin CHARACTERISTIC Cal_Ti_Tar_OpenBrk "" VALUE 0x70028eb4 __UWORD_S 0 NO_COMPU_METHOD -2147483648 2147483647 FORMAT "%.15" /end CHARACTERISTIC
/begin CHARACTERISTIC Cal_Ti_Tar_OpenBrk_P_Cmp1 "" VALUE 0x70028eb6 __UWORD_S 0 NO_COMPU_METHOD -2147483648 2147483647 FORMAT "%.15" /end CHARACTERISTIC
/begin CHARACTERISTIC Cal_Ti_Tar_OpenBrk_P_Cmp2 "" VALUE 0x70028eb8 __UWORD_S 0 NO_COMPU_METHOD -2147483648 2147483647 FORMAT "%.15" /end CHARACTERISTIC
/begin CHARACTERISTIC Cal_Ti_Tar_OpenBrk_P_Cmp3 "" VALUE 0x70028eba __UWORD_S 0 NO_COMPU_METHOD -2147483648 2147483647 FORMAT "%.15" /end CHARACTERISTIC
/begin CHARACTERISTIC Cal_Ti_Tar_RollrStepCls0 "" VALUE 0x70028ebc __UWORD_S 0 NO_COMPU_METHOD -2147483648 2147483647 FORMAT "%.15" /end CHARACTERISTIC
/begin CHARACTERISTIC Cal_Ti_Tar_RollrStepCls1 "" VALUE 0x70028ebe __UWORD_S 0 NO_COMPU_METHOD -2147483648 2147483647 FORMAT "%.15" /end CHARACTERISTIC
/begin CHARACTERISTIC Cal_Ti_Tar_RollrStepCls2 "" VALUE 0x70028ec0 __UWORD_S 0 NO_COMPU_METHOD -2147483648 2147483647 FORMAT "%.15" /end CHARACTERISTIC
/begin CHARACTERISTIC Cal_Ti_Tar_RollrStepCls3 "" VALUE 0x70028ec2 __UWORD_S 0 NO_COMPU_METHOD -2147483648 2147483647 FORMAT "%.15" /end CHARACTERISTIC
/begin CHARACTERISTIC Cal_Ti_Tolr_Drvr_Resp_Max "" VALUE 0x70028ec4 __UWORD_S 0 NO_COMPU_METHOD -2147483648 2147483647 FORMAT "%.15" /end CHARACTERISTIC
/begin CHARACTERISTIC Cal_Ti_Tolr_Host_Avl_Max "" VALUE 0x70028ec6 __UWORD_S 0 NO_COMPU_METHOD -2147483648 2147483647 FORMAT "%.15" /end CHARACTERISTIC
/begin CHARACTERISTIC Cal_U_Thd_Sply0 "" VALUE 0x70028ec8 __UWORD_S 0 NO_COMPU_METHOD -2147483648 2147483647 FORMAT "%.15" /end CHARACTERISTIC
/begin CHARACTERISTIC Cal_U_Thd_Sply1 "" VALUE 0x70028eca __UWORD_S 0 NO_COMPU_METHOD -2147483648 2147483647 FORMAT "%.15" /end CHARACTERISTIC
/begin CHARACTERISTIC Cal_U_Thd_Sply2 "" VALUE 0x70028ecc __UWORD_S 0 NO_COMPU_METHOD -2147483648 2147483647 FORMAT "%.15" /end CHARACTERISTIC
/begin CHARACTERISTIC Cal_U_Thd_Sply3 "" VALUE 0x70028ece __UWORD_S 0 NO_COMPU_METHOD -2147483648 2147483647 FORMAT "%.15" /end CHARACTERISTIC
/begin CHARACTERISTIC Cal_U_Thd_Sply4 "" VALUE 0x70028ed0 __UWORD_S 0 NO_COMPU_METHOD -2147483648 2147483647 FORMAT "%.15" /end CHARACTERISTIC
/begin CHARACTERISTIC Cal_U_Thd_Sply5 "" VALUE 0x70028ed2 __UWORD_S 0 NO_COMPU_METHOD -2147483648 2147483647 FORMAT "%.15" /end CHARACTERISTIC
/begin CHARACTERISTIC Cfg_Actn_Coeff "" VALUE 0x70028ed4 __UWORD_S 0 NO_COMPU_METHOD -2147483648 2147483647 FORMAT "%.15" /end CHARACTERISTIC
/begin CHARACTERISTIC Cfg_Cp_Therm_Dsc "" VALUE 0x70028ed6 __UWORD_S 0 NO_COMPU_METHOD -2147483648 2147483647 FORMAT "%.15" /end CHARACTERISTIC
/begin CHARACTERISTIC Cfg_Dgrd_Ctrl_Mat "" VALUE 0x70028ed8 __UWORD_S 0 NO_COMPU_METHOD -2147483648 2147483647 FORMAT "%.15" /end CHARACTERISTIC
/begin CHARACTERISTIC Cfg_Dgrd_Req_Mat "" VALUE 0x70028ef6 __UWORD_S 0 NO_COMPU_METHOD -2147483648 2147483647 FORMAT "%.15" /end CHARACTERISTIC
/begin CHARACTERISTIC Cfg_Epb_Req_Map "" VALUE 0x7002914e __UWORD_S 0 NO_COMPU_METHOD -2147483648 2147483647 FORMAT "%.15" /end CHARACTERISTIC
/begin CHARACTERISTIC Cfg_F_Clmp_Div_Gain "" VALUE 0x70029176 __UWORD_S 0 NO_COMPU_METHOD -2147483648 2147483647 FORMAT "%.15" /end CHARACTERISTIC
/begin CHARACTERISTIC Cfg_Fric_Pad "" VALUE 0x70029178 __UWORD_S 0 NO_COMPU_METHOD -2147483648 2147483647 FORMAT "%.15" /end CHARACTERISTIC
/begin CHARACTERISTIC Cfg_Grdt_Worst "" VALUE 0x7002917a __UWORD_S 0 NO_COMPU_METHOD -2147483648 2147483647 FORMAT "%.15" /end CHARACTERISTIC
/begin CHARACTERISTIC Cfg_Lpf_Gain_Decel "" VALUE 0x7002917c __UWORD_S 0 NO_COMPU_METHOD -2147483648 2147483647 FORMAT "%.15" /end CHARACTERISTIC
/begin CHARACTERISTIC Cfg_Lpf_Gain_Lgt_A "" VALUE 0x7002917e __UWORD_S 0 NO_COMPU_METHOD -2147483648 2147483647 FORMAT "%.15" /end CHARACTERISTIC
/begin CHARACTERISTIC Cfg_Lpf_Gain_Mot_I "" VALUE 0x70029180 __UWORD_S 0 NO_COMPU_METHOD -2147483648 2147483647 FORMAT "%.15" /end CHARACTERISTIC
/begin CHARACTERISTIC Cfg_Lpf_Gain_Mot_U "" VALUE 0x70029182 __UWORD_S 0 NO_COMPU_METHOD -2147483648 2147483647 FORMAT "%.15" /end CHARACTERISTIC
/begin CHARACTERISTIC Cfg_Posn_Spndl_Rel_Def "" VALUE 0x70029184 __UWORD_S 0 NO_COMPU_METHOD -2147483648 2147483647 FORMAT "%.15" /end CHARACTERISTIC
/begin CHARACTERISTIC Cfg_R_Mot "" VALUE 0x70029188 __UWORD_S 0 NO_COMPU_METHOD -2147483648 2147483647 FORMAT "%.15" /end CHARACTERISTIC
/begin CHARACTERISTIC Cfg_Rd_Cyl_Pist "" VALUE 0x7002918a __UWORD_S 0 NO_COMPU_METHOD -2147483648 2147483647 FORMAT "%.15" /end CHARACTERISTIC
/begin CHARACTERISTIC Cfg_Rd_Dsc "" VALUE 0x7002918c __UWORD_S 0 NO_COMPU_METHOD -2147483648 2147483647 FORMAT "%.15" /end CHARACTERISTIC
/begin CHARACTERISTIC Cfg_Rd_Tire "" VALUE 0x7002918e __UWORD_S 0 NO_COMPU_METHOD -2147483648 2147483647 FORMAT "%.15" /end CHARACTERISTIC
/begin CHARACTERISTIC Cfg_Spd_Thd_Delta_Whl_Max "" VALUE 0x70029190 __UWORD_S 0 NO_COMPU_METHOD -2147483648 2147483647 FORMAT "%.15" /end CHARACTERISTIC
/begin CHARACTERISTIC Cfg_Spd_Thd_Rollg0 "" VALUE 0x70029192 __UWORD_S 0 NO_COMPU_METHOD -2147483648 2147483647 FORMAT "%.15" /end CHARACTERISTIC
/begin CHARACTERISTIC Cfg_Spd_Thd_Rollg1 "" VALUE 0x70029194 __UWORD_S 0 NO_COMPU_METHOD -2147483648 2147483647 FORMAT "%.15" /end CHARACTERISTIC
/begin CHARACTERISTIC Cfg_T_Amb_Default "" VALUE 0x70029196 __UWORD_S 0 NO_COMPU_METHOD -2147483648 2147483647 FORMAT "%.15" /end CHARACTERISTIC
/begin CHARACTERISTIC Cfg_Ti_Intl_Cfm_CmplyOpen_Done "" VALUE 0x70029198 __UWORD_S 0 NO_COMPU_METHOD -2147483648 2147483647 FORMAT "%.15" /end CHARACTERISTIC
/begin CHARACTERISTIC Cfg_Ti_Intl_Hill_Det "" VALUE 0x7002919a __UWORD_S 0 NO_COMPU_METHOD -2147483648 2147483647 FORMAT "%.15" /end CHARACTERISTIC
/begin CHARACTERISTIC Cfg_Ti_Intl_Mon_SplyU "" VALUE 0x7002919c __UWORD_S 0 NO_COMPU_METHOD -2147483648 2147483647 FORMAT "%.15" /end CHARACTERISTIC
/begin CHARACTERISTIC Cfg_Ti_Intl_Stagger "" VALUE 0x7002919e __UWORD_S 0 NO_COMPU_METHOD -2147483648 2147483647 FORMAT "%.15" /end CHARACTERISTIC
/begin CHARACTERISTIC Cfg_Ti_Tar_Stop_Mot_Dyn_Min "" VALUE 0x700291a0 __UWORD_S 0 NO_COMPU_METHOD -2147483648 2147483647 FORMAT "%.15" /end CHARACTERISTIC
/begin CHARACTERISTIC Cfg_Ti_Tar_Stop_Mot_Stat_Min "" VALUE 0x700291a2 __UWORD_S 0 NO_COMPU_METHOD -2147483648 2147483647 FORMAT "%.15" /end CHARACTERISTIC
/begin CHARACTERISTIC Cfg_Ti_Tout_Stop_Mot "" VALUE 0x700291a4 __UWORD_S 0 NO_COMPU_METHOD -2147483648 2147483647 FORMAT "%.15" /end CHARACTERISTIC
/begin CHARACTERISTIC Cfg_Typ_Embo "" VALUE 0x700291a6 __UWORD_S 0 NO_COMPU_METHOD -2147483648 2147483647 FORMAT "%.15" /end CHARACTERISTIC
/begin CHARACTERISTIC Cfg_Typ_Moc "" VALUE 0x700291a7 __UWORD_S 0 NO_COMPU_METHOD -2147483648 2147483647 FORMAT "%.15" /end CHARACTERISTIC
/begin CHARACTERISTIC Cfg_Typ_Pls "" VALUE 0x700291a8 __UWORD_S 0 NO_COMPU_METHOD -2147483648 2147483647 FORMAT "%.15" /end CHARACTERISTIC
/begin CHARACTERISTIC Cfg_Typ_Veh_Drv "" VALUE 0x700291a9 __UWORD_S 0 NO_COMPU_METHOD -2147483648 2147483647 FORMAT "%.15" /end CHARACTERISTIC
/begin CHARACTERISTIC Cfg_U_Sply_Thd_Oper_Over "" VALUE 0x700291aa __UWORD_S 0 NO_COMPU_METHOD -2147483648 2147483647 FORMAT "%.15" /end CHARACTERISTIC
/begin CHARACTERISTIC Cfg_U_Sply_Thd_Oper_Under "" VALUE 0x700291ac __UWORD_S 0 NO_COMPU_METHOD -2147483648 2147483647 FORMAT "%.15" /end CHARACTERISTIC
/begin CHARACTERISTIC Cfg_Wght_Dsc "" VALUE 0x700291ae __UWORD_S 0 NO_COMPU_METHOD -2147483648 2147483647 FORMAT "%.15" /end CHARACTERISTIC
/begin CHARACTERISTIC CyclicFuncFlg "" VALUE 0x700291b1 __UWORD_S 0 NO_COMPU_METHOD -2147483648 2147483647 FORMAT "%.15" /end CHARACTERISTIC
/begin MEASUREMENT pQualRollrBench "" SLONG eMdRollr 0 0 -2147483648 2147483647 ECU_ADDRESS 0x700291b4 FORMAT "%.15" /end MEASUREMENT
/begin MEASUREMENT pSnsrVehDrvAwy "" SLONG eMdDrvAwy 0 0 -2147483648 2147483647 ECU_ADDRESS 0x700291b8 FORMAT "%.15" /end MEASUREMENT
/begin MEASUREMENT pSnsrDynLgtA "" SWORD NO_COMPU_METHOD 0 0 -32768 32767 ECU_ADDRESS 0x700291bc FORMAT "%.15" /end MEASUREMENT
/begin MEASUREMENT pSnsrDynWhlPReltyFL "" SLONG eMdWhlPRelty 0 0 -2147483648 2147483647 ECU_ADDRESS 0x700291c0 FORMAT "%.15" /end MEASUREMENT
/begin MEASUREMENT pSnsrDynWhlPReltyFR "" SLONG eMdWhlPRelty 0 0 -2147483648 2147483647 ECU_ADDRESS 0x700291c4 FORMAT "%.15" /end MEASUREMENT
/begin MEASUREMENT pSnsrDynWhlPReltyRL "" SLONG eMdWhlPRelty 0 0 -2147483648 2147483647 ECU_ADDRESS 0x700291c8 FORMAT "%.15" /end MEASUREMENT
/begin MEASUREMENT pSnsrDynWhlPReltyRR "" SLONG eMdWhlPRelty 0 0 -2147483648 2147483647 ECU_ADDRESS 0x700291cc FORMAT "%.15" /end MEASUREMENT
/begin MEASUREMENT pSnsrVehEngCrkng "" SLONG NO_COMPU_METHOD 0 0 -2147483648 2147483647 ECU_ADDRESS 0x700291d0 FORMAT "%.15" /end MEASUREMENT
/begin MEASUREMENT pSnsrHpsAvlty "" SLONG eMdHpsAvlty 0 0 -2147483648 2147483647 ECU_ADDRESS 0x700291d4 FORMAT "%.15" /end MEASUREMENT
/begin MEASUREMENT pSnsrHpsAck "" SLONG eMdHpsAck 0 0 -2147483648 2147483647 ECU_ADDRESS 0x700291d8 FORMAT "%.15" /end MEASUREMENT
/begin MEASUREMENT pRcvryFltSts "" SLONG eMdFltRecvry 0 0 -2147483648 2147483647 ECU_ADDRESS 0x700291dc FORMAT "%.15" /end MEASUREMENT
/begin MEASUREMENT pStorgVal1 "" SLONG eMdStorgQual 0 0 -2147483648 2147483647 ECU_ADDRESS 0x7002927c FORMAT "%.15" /end MEASUREMENT
/begin MEASUREMENT pStorgVal2 "" SLONG eMdStorgQual 0 0 -2147483648 2147483647 ECU_ADDRESS 0x70029280 FORMAT "%.15" /end MEASUREMENT
/begin MEASUREMENT pStorgVal3 "" SLONG eMdStorgQual 0 0 -2147483648 2147483647 ECU_ADDRESS 0x70029284 FORMAT "%.15" /end MEASUREMENT
/begin MEASUREMENT pSnsrVehPwrDwn "" SLONG eMdPwrDwn 0 0 -2147483648 2147483647 ECU_ADDRESS 0x70029288 FORMAT "%.15" /end MEASUREMENT
/begin MEASUREMENT pSnsrHostAvltyRL "" SLONG eMdHostAvlty 0 0 -2147483648 2147483647 ECU_ADDRESS 0x7002928c FORMAT "%.15" /end MEASUREMENT
/begin MEASUREMENT pSnsrHostAvltyRR "" SLONG eMdHostAvlty 0 0 -2147483648 2147483647 ECU_ADDRESS 0x70029290 FORMAT "%.15" /end MEASUREMENT
/begin MEASUREMENT pSnsrMotDrvrStRL "" SLONG NO_COMPU_METHOD 0 0 -2147483648 2147483647 ECU_ADDRESS 0x70029294 FORMAT "%.15" /end MEASUREMENT
/begin MEASUREMENT pSnsrMotDrvrStRR "" SLONG NO_COMPU_METHOD 0 0 -2147483648 2147483647 ECU_ADDRESS 0x70029298 FORMAT "%.15" /end MEASUREMENT
/begin MEASUREMENT pSnsrVehPwrSplySt "" SLONG NO_COMPU_METHOD 0 0 -2147483648 2147483647 ECU_ADDRESS 0x7002929c FORMAT "%.15" /end MEASUREMENT
/begin MEASUREMENT pSnsrDynWhlPlsFR "" UBYTE NO_COMPU_METHOD 0 0 0 255 ECU_ADDRESS 0x700292a0 FORMAT "%.15" /end MEASUREMENT
/begin MEASUREMENT pSnsrDynWhlPlsRL "" UBYTE NO_COMPU_METHOD 0 0 0 255 ECU_ADDRESS 0x700292a1 FORMAT "%.15" /end MEASUREMENT
/begin MEASUREMENT pSnsrDynWhlPlsRR "" UBYTE NO_COMPU_METHOD 0 0 0 255 ECU_ADDRESS 0x700292a2 FORMAT "%.15" /end MEASUREMENT
/begin MEASUREMENT pSnsrDynWhlSpdFL "" SWORD NO_COMPU_METHOD 0 0 -32768 32767 ECU_ADDRESS 0x700292a4 FORMAT "%.15" /end MEASUREMENT
/begin MEASUREMENT pSnsrDynWhlSpdFR "" SWORD NO_COMPU_METHOD 0 0 -32768 32767 ECU_ADDRESS 0x700292a6 FORMAT "%.15" /end MEASUREMENT
/begin MEASUREMENT pSnsrDynWhlSpdRL "" SWORD NO_COMPU_METHOD 0 0 -32768 32767 ECU_ADDRESS 0x700292a8 FORMAT "%.15" /end MEASUREMENT
/begin MEASUREMENT pSnsrDynWhlSpdRR "" SWORD NO_COMPU_METHOD 0 0 -32768 32767 ECU_ADDRESS 0x700292aa FORMAT "%.15" /end MEASUREMENT
/begin MEASUREMENT pSnsrVehAmbT "" SWORD NO_COMPU_METHOD 0 0 -32768 32767 ECU_ADDRESS 0x700292ac FORMAT "%.15" /end MEASUREMENT
/begin MEASUREMENT pSnsrDynMstCylP "" UWORD NO_COMPU_METHOD 0 0 0 65535 ECU_ADDRESS 0x700292ae FORMAT "%.15" /end MEASUREMENT
/begin MEASUREMENT pSnsrDynWhlPFL "" UWORD NO_COMPU_METHOD 0 0 0 65535 ECU_ADDRESS 0x700292b0 FORMAT "%.15" /end MEASUREMENT
/begin MEASUREMENT pSnsrDynWhlPFR "" UWORD NO_COMPU_METHOD 0 0 0 65535 ECU_ADDRESS 0x700292b2 FORMAT "%.15" /end MEASUREMENT
/begin MEASUREMENT pSnsrDynWhlPRL "" UWORD NO_COMPU_METHOD 0 0 0 65535 ECU_ADDRESS 0x700292b4 FORMAT "%.15" /end MEASUREMENT
/begin MEASUREMENT pSnsrDynWhlPRR "" UWORD NO_COMPU_METHOD 0 0 0 65535 ECU_ADDRESS 0x700292b6 FORMAT "%.15" /end MEASUREMENT
/begin MEASUREMENT pSnsrVehMilg "" ULONG NO_COMPU_METHOD 0 0 0 4294967295 ECU_ADDRESS 0x700292b8 FORMAT "%.15" /end MEASUREMENT
/begin MEASUREMENT pSnsrVehPbcSleepTi "" UWORD NO_COMPU_METHOD 0 0 0 65535 ECU_ADDRESS 0x700292bc FORMAT "%.15" /end MEASUREMENT
/begin MEASUREMENT pSnsrMotIRL "" SWORD NO_COMPU_METHOD 0 0 -32768 32767 ECU_ADDRESS 0x700292be FORMAT "%.15" /end MEASUREMENT
/begin MEASUREMENT pSnsrMotIRR "" SWORD NO_COMPU_METHOD 0 0 -32768 32767 ECU_ADDRESS 0x700292d2 FORMAT "%.15" /end MEASUREMENT
/begin MEASUREMENT pSnsrVehMotDrvrSplyU "" SWORD NO_COMPU_METHOD 0 0 -32768 32767 ECU_ADDRESS 0x700292e6 FORMAT "%.15" /end MEASUREMENT
/begin MEASUREMENT pSnsrMotURL "" SWORD NO_COMPU_METHOD 0 0 -32768 32767 ECU_ADDRESS 0x700292e8 FORMAT "%.15" /end MEASUREMENT
/begin MEASUREMENT pSnsrMotURR "" SWORD NO_COMPU_METHOD 0 0 -32768 32767 ECU_ADDRESS 0x700292fc FORMAT "%.15" /end MEASUREMENT
/begin MEASUREMENT pReadStorg "" UBYTE NO_COMPU_METHOD 0 0 0 255 ECU_ADDRESS 0x70029310 FORMAT "%.15" /end MEASUREMENT
/begin MEASUREMENT pSnsrVehHostSwVer "" SLONG NO_COMPU_METHOD 0 0 -2147483648 2147483647 ECU_ADDRESS 0x70029410 FORMAT "%.15" /end MEASUREMENT
/begin MEASUREMENT pSnsrVehVrntItem "" UBYTE NO_COMPU_METHOD 0 0 0 255 ECU_ADDRESS 0x70029416 FORMAT "%.15" /end MEASUREMENT
/begin MEASUREMENT pEngdErrPbcInEnum "" SLONG eMdFltSts 0 0 -2147483648 2147483647 ECU_ADDRESS 0x70029458 FORMAT "%.15" /end MEASUREMENT
/begin MEASUREMENT pDrvrMotCmdRL "" SLONG NO_COMPU_METHOD 0 0 -2147483648 2147483647 ECU_ADDRESS 0x7002945c FORMAT "%.15" /end MEASUREMENT
/begin MEASUREMENT pEngdFltSts "" SLONG eMdFltSts 0 0 -2147483648 2147483647 ECU_ADDRESS 0x70029460 FORMAT "%.15" /end MEASUREMENT
/begin MEASUREMENT pLogdFSActrUnknown "" SLONG eMdFltSts 0 0 -2147483648 2147483647 ECU_ADDRESS 0x70029500 FORMAT "%.15" /end MEASUREMENT
/begin MEASUREMENT pLogdFSAsmblyChk "" SLONG eMdFltSts 0 0 -2147483648 2147483647 ECU_ADDRESS 0x70029504 FORMAT "%.15" /end MEASUREMENT
/begin MEASUREMENT pLogdFSExecSeqErr "" SLONG eMdFltSts 0 0 -2147483648 2147483647 ECU_ADDRESS 0x70029508 FORMAT "%.15" /end MEASUREMENT
/begin MEASUREMENT pLogdFSHostAvltyRL "" SLONG eMdFltSts 0 0 -2147483648 2147483647 ECU_ADDRESS 0x7002950c FORMAT "%.15" /end MEASUREMENT
/begin MEASUREMENT pLogdFSHostAvltyRR "" SLONG eMdFltSts 0 0 -2147483648 2147483647 ECU_ADDRESS 0x70029510 FORMAT "%.15" /end MEASUREMENT
/begin MEASUREMENT pLogdFSMotDrvrStRL "" SLONG eMdFltSts 0 0 -2147483648 2147483647 ECU_ADDRESS 0x70029514 FORMAT "%.15" /end MEASUREMENT
/begin MEASUREMENT pLogdFSMotDrvrStRR "" SLONG eMdFltSts 0 0 -2147483648 2147483647 ECU_ADDRESS 0x70029518 FORMAT "%.15" /end MEASUREMENT
/begin MEASUREMENT pLogdFSMotOvldRL "" SLONG eMdFltSts 0 0 -2147483648 2147483647 ECU_ADDRESS 0x7002951c FORMAT "%.15" /end MEASUREMENT
/begin MEASUREMENT pLogdFSMotOvldRR "" SLONG eMdFltSts 0 0 -2147483648 2147483647 ECU_ADDRESS 0x70029520 FORMAT "%.15" /end MEASUREMENT
/begin MEASUREMENT pLogdFSMotOvrunRL "" SLONG eMdFltSts 0 0 -2147483648 2147483647 ECU_ADDRESS 0x70029524 FORMAT "%.15" /end MEASUREMENT
/begin MEASUREMENT pLogdFSMotOvrunRR "" SLONG eMdFltSts 0 0 -2147483648 2147483647 ECU_ADDRESS 0x70029528 FORMAT "%.15" /end MEASUREMENT
/begin MEASUREMENT pLogdFSMotStuck1RL "" SLONG eMdFltSts 0 0 -2147483648 2147483647 ECU_ADDRESS 0x7002952c FORMAT "%.15" /end MEASUREMENT
/begin MEASUREMENT pLogdFSMotStuck1RR "" SLONG eMdFltSts 0 0 -2147483648 2147483647 ECU_ADDRESS 0x70029530 FORMAT "%.15" /end MEASUREMENT
/begin MEASUREMENT pLogdFSMotStuck2RL "" SLONG eMdFltSts 0 0 -2147483648 2147483647 ECU_ADDRESS 0x70029534 FORMAT "%.15" /end MEASUREMENT
/begin MEASUREMENT pLogdFSMotStuck2RR "" SLONG eMdFltSts 0 0 -2147483648 2147483647 ECU_ADDRESS 0x70029538 FORMAT "%.15" /end MEASUREMENT
/begin MEASUREMENT pLogdFSMotStuck3RL "" SLONG eMdFltSts 0 0 -2147483648 2147483647 ECU_ADDRESS 0x7002953c FORMAT "%.15" /end MEASUREMENT
/begin MEASUREMENT pLogdFSMotStuck3RR "" SLONG eMdFltSts 0 0 -2147483648 2147483647 ECU_ADDRESS 0x70029540 FORMAT "%.15" /end MEASUREMENT
/begin MEASUREMENT pLogdFSPwrDwnUnexpted "" SLONG eMdFltSts 0 0 -2147483648 2147483647 ECU_ADDRESS 0x70029544 FORMAT "%.15" /end MEASUREMENT
/begin MEASUREMENT pLogdFSReclmpExcd "" SLONG eMdFltSts 0 0 -2147483648 2147483647 ECU_ADDRESS 0x70029548 FORMAT "%.15" /end MEASUREMENT
/begin MEASUREMENT pWarnDataStorgReq "" SLONG NO_COMPU_METHOD 0 0 -2147483648 2147483647 ECU_ADDRESS 0x7002954c FORMAT "%.15" /end MEASUREMENT
/begin MEASUREMENT pDrvrExtPrkSprtReq "" SLONG eMdOperActvn 0 0 -2147483648 2147483647 ECU_ADDRESS 0x70029550 FORMAT "%.15" /end MEASUREMENT
/begin MEASUREMENT pTrigReclmpBmpup "" SLONG eMdOperActvn 0 0 -2147483648 2147483647 ECU_ADDRESS 0x70029554 FORMAT "%.15" /end MEASUREMENT
/begin MEASUREMENT pWarnOutOfSpecMsg "" SLONG NO_COMPU_METHOD 0 0 -2147483648 2147483647 ECU_ADDRESS 0x70029558 FORMAT "%.15" /end MEASUREMENT
/begin MEASUREMENT pDrvrHpsReq "" SLONG eMdExtHpsPGrdt 0 0 -2147483648 2147483647 ECU_ADDRESS 0x7002955c FORMAT "%.15" /end MEASUREMENT
/begin MEASUREMENT pEngdErrPwrSply "" SLONG eMdPwrSplyErr 0 0 -2147483648 2147483647 ECU_ADDRESS 0x70029560 FORMAT "%.15" /end MEASUREMENT
/begin MEASUREMENT pStsDiagReq "" SLONG eMdDiagReqSts 0 0 -2147483648 2147483647 ECU_ADDRESS 0x70029564 FORMAT "%.15" /end MEASUREMENT
/begin MEASUREMENT pActvdWhlPFL "" UWORD NO_COMPU_METHOD 0 0 0 65535 ECU_ADDRESS 0x70029568 FORMAT "%.15" /end MEASUREMENT
/begin MEASUREMENT pActvdWhlPFR "" UWORD NO_COMPU_METHOD 0 0 0 65535 ECU_ADDRESS 0x7002956a FORMAT "%.15" /end MEASUREMENT
/begin MEASUREMENT pLogdWhlPRL "" UWORD NO_COMPU_METHOD 0 0 0 65535 ECU_ADDRESS 0x7002956c FORMAT "%.15" /end MEASUREMENT
/begin MEASUREMENT pLogdWhlPRR "" UWORD NO_COMPU_METHOD 0 0 0 65535 ECU_ADDRESS 0x7002956e FORMAT "%.15" /end MEASUREMENT
/begin MEASUREMENT pEngdPbcSwVer "" SLONG NO_COMPU_METHOD 0 0 -2147483648 2147483647 ECU_ADDRESS 0x70029570 FORMAT "%.15" /end MEASUREMENT
/begin MEASUREMENT pWrStorg "" UBYTE NO_COMPU_METHOD 0 0 0 255 ECU_ADDRESS 0x70029576 FORMAT "%.15" /end MEASUREMENT
/begin MEASUREMENT pActvdFSSeqMon "" SLONG NO_COMPU_METHOD 0 0 -2147483648 2147483647 ECU_ADDRESS 0x70029704 FORMAT "%.15" /end MEASUREMENT
/begin MEASUREMENT pEngdActrStIntRL "" SLONG eMdActrStInt 0 0 -2147483648 2147483647 ECU_ADDRESS 0x70029708 FORMAT "%.15" /end MEASUREMENT
/begin MEASUREMENT pEngdActrStIntRR "" SLONG eMdActrStInt 0 0 -2147483648 2147483647 ECU_ADDRESS 0x7002970c FORMAT "%.15" /end MEASUREMENT
/begin MEASUREMENT pEngdOperCntrEpbRL "" ULONG NO_COMPU_METHOD 0 0 0 4294967295 ECU_ADDRESS 0x70029710 FORMAT "%.15" /end MEASUREMENT
/begin MEASUREMENT pEngdOperCntrEpbRR "" ULONG NO_COMPU_METHOD 0 0 0 4294967295 ECU_ADDRESS 0x70029714 FORMAT "%.15" /end MEASUREMENT
/begin MEASUREMENT pDgrdAsmblyChk "" SLONG eMdFltSts 0 0 -2147483648 2147483647 ECU_ADDRESS 0x70029718 FORMAT "%.15" /end MEASUREMENT
/begin MEASUREMENT pDgrdReclmpExcd "" SLONG eMdFltSts 0 0 -2147483648 2147483647 ECU_ADDRESS 0x7002971c FORMAT "%.15" /end MEASUREMENT
/begin MEASUREMENT pDgrdMotOvldRL "" SLONG eMdFltSts 0 0 -2147483648 2147483647 ECU_ADDRESS 0x70029720 FORMAT "%.15" /end MEASUREMENT
/begin MEASUREMENT pDgrdMotOvldRR "" SLONG eMdFltSts 0 0 -2147483648 2147483647 ECU_ADDRESS 0x70029724 FORMAT "%.15" /end MEASUREMENT
/begin MEASUREMENT pDgrdMotOvrunRL "" SLONG eMdFltSts 0 0 -2147483648 2147483647 ECU_ADDRESS 0x70029728 FORMAT "%.15" /end MEASUREMENT
/begin MEASUREMENT pDgrdMotOvrunRR "" SLONG eMdFltSts 0 0 -2147483648 2147483647 ECU_ADDRESS 0x7002972c FORMAT "%.15" /end MEASUREMENT
/begin MEASUREMENT pDgrdMotStuck1RL "" SLONG eMdFltSts 0 0 -2147483648 2147483647 ECU_ADDRESS 0x70029730 FORMAT "%.15" /end MEASUREMENT
/begin MEASUREMENT pDgrdMotStuck1RR "" SLONG eMdFltSts 0 0 -2147483648 2147483647 ECU_ADDRESS 0x70029734 FORMAT "%.15" /end MEASUREMENT
/begin MEASUREMENT pDgrdPwrDwnUnexpted "" SLONG eMdFltSts 0 0 -2147483648 2147483647 ECU_ADDRESS 0x70029738 FORMAT "%.15" /end MEASUREMENT
/begin MEASUREMENT pDgrdExecSeqErr "" SLONG eMdFltSts 0 0 -2147483648 2147483647 ECU_ADDRESS 0x7002973c FORMAT "%.15" /end MEASUREMENT
/begin MEASUREMENT pEngdMotIdleIRL "" SWORD NO_COMPU_METHOD 0 0 -32768 32767 ECU_ADDRESS 0x70029740 FORMAT "%.15" /end MEASUREMENT
/begin MEASUREMENT pEngdMotIdleIRR "" SWORD NO_COMPU_METHOD 0 0 -32768 32767 ECU_ADDRESS 0x70029742 FORMAT "%.15" /end MEASUREMENT
/begin MEASUREMENT pActvdMotIRL "" SWORD NO_COMPU_METHOD 0 0 -32768 32767 ECU_ADDRESS 0x70029744 FORMAT "%.15" /end MEASUREMENT
/begin MEASUREMENT pActvdMotIRR "" SWORD NO_COMPU_METHOD 0 0 -32768 32767 ECU_ADDRESS 0x70029746 FORMAT "%.15" /end MEASUREMENT
/begin MEASUREMENT pEngdSpndlTrvlPosnRL "" SLONG NO_COMPU_METHOD 0 0 -2147483648 2147483647 ECU_ADDRESS 0x70029748 FORMAT "%.15" /end MEASUREMENT
/begin MEASUREMENT pEngdSpndlTrvlPosnRR "" SLONG NO_COMPU_METHOD 0 0 -2147483648 2147483647 ECU_ADDRESS 0x7002974c FORMAT "%.15" /end MEASUREMENT
/begin MEASUREMENT pLogdSpndlTrvlPosnRL "" SLONG NO_COMPU_METHOD 0 0 -2147483648 2147483647 ECU_ADDRESS 0x70029750 FORMAT "%.15" /end MEASUREMENT
/begin MEASUREMENT pLogdSpndlTrvlPosnRR "" SLONG NO_COMPU_METHOD 0 0 -2147483648 2147483647 ECU_ADDRESS 0x70029754 FORMAT "%.15" /end MEASUREMENT
/begin MEASUREMENT pEngdMilg "" ULONG NO_COMPU_METHOD 0 0 0 4294967295 ECU_ADDRESS 0x70029758 FORMAT "%.15" /end MEASUREMENT
/begin MEASUREMENT pEngdOperTi "" ULONG NO_COMPU_METHOD 0 0 0 4294967295 ECU_ADDRESS 0x7002975c FORMAT "%.15" /end MEASUREMENT
/begin MEASUREMENT pLogdOperCntrEpbRL "" ULONG NO_COMPU_METHOD 0 0 0 4294967295 ECU_ADDRESS 0x70029760 FORMAT "%.15" /end MEASUREMENT
/begin MEASUREMENT pLogdOperCntrEpbRR "" ULONG NO_COMPU_METHOD 0 0 0 4294967295 ECU_ADDRESS 0x70029764 FORMAT "%.15" /end MEASUREMENT
/begin MEASUREMENT pLogdMilg "" ULONG NO_COMPU_METHOD 0 0 0 4294967295 ECU_ADDRESS 0x70029768 FORMAT "%.15" /end MEASUREMENT
/begin MEASUREMENT pLogdOperTi "" ULONG NO_COMPU_METHOD 0 0 0 4294967295 ECU_ADDRESS 0x7002976c FORMAT "%.15" /end MEASUREMENT
/begin MEASUREMENT pQualPwrDwnUnexptd "" SLONG eMdPwrDwn 0 0 -2147483648 2147483647 ECU_ADDRESS 0x70029770 FORMAT "%.15" /end MEASUREMENT
/begin MEASUREMENT pEngdMotIPhaRL "" SLONG eMdMotIPha 0 0 -2147483648 2147483647 ECU_ADDRESS 0x70029774 FORMAT "%.15" /end MEASUREMENT
/begin MEASUREMENT pEngdMotIPhaRR "" SLONG eMdMotIPha 0 0 -2147483648 2147483647 ECU_ADDRESS 0x70029778 FORMAT "%.15" /end MEASUREMENT
/begin MEASUREMENT pQualSysMod "" SLONG eMdSysMod 0 0 -2147483648 2147483647 ECU_ADDRESS 0x7002977c FORMAT "%.15" /end MEASUREMENT
/begin MEASUREMENT pActvdVehSpd "" SWORD NO_COMPU_METHOD 0 0 -32768 32767 ECU_ADDRESS 0x70029780 FORMAT "%.15" /end MEASUREMENT
/begin MEASUREMENT pActvdWhlSpdRL "" SWORD NO_COMPU_METHOD 0 0 -32768 32767 ECU_ADDRESS 0x70029782 FORMAT "%.15" /end MEASUREMENT
/begin MEASUREMENT pActvdWhlSpdRR "" SWORD NO_COMPU_METHOD 0 0 -32768 32767 ECU_ADDRESS 0x70029784 FORMAT "%.15" /end MEASUREMENT
/begin MEASUREMENT pActvdMotURL "" SWORD NO_COMPU_METHOD 0 0 -32768 32767 ECU_ADDRESS 0x70029786 FORMAT "%.15" /end MEASUREMENT
/begin MEASUREMENT pActvdMotURR "" SWORD NO_COMPU_METHOD 0 0 -32768 32767 ECU_ADDRESS 0x70029788 FORMAT "%.15" /end MEASUREMENT
/begin MEASUREMENT pEngdClmpFRL "" UWORD NO_COMPU_METHOD 0 0 0 65535 ECU_ADDRESS 0x7002978a FORMAT "%.15" /end MEASUREMENT
/begin MEASUREMENT pEngdClmpFRR "" UWORD NO_COMPU_METHOD 0 0 0 65535 ECU_ADDRESS 0x7002978c FORMAT "%.15" /end MEASUREMENT
/begin MEASUREMENT pEngdOperCntrRARTmp "" UBYTE NO_COMPU_METHOD 0 0 0 255 ECU_ADDRESS 0x7002978e FORMAT "%.15" /end MEASUREMENT
/begin MEASUREMENT pEngdOperCntrASM "" UBYTE NO_COMPU_METHOD 0 0 0 255 ECU_ADDRESS 0x7002978f FORMAT "%.15" /end MEASUREMENT
/begin MEASUREMENT pDgrdHostUnavlRL "" SLONG eMdFltSts 0 0 -2147483648 2147483647 ECU_ADDRESS 0x70029790 FORMAT "%.15" /end MEASUREMENT
/begin MEASUREMENT pDgrdHostUnavlRR "" SLONG eMdFltSts 0 0 -2147483648 2147483647 ECU_ADDRESS 0x70029794 FORMAT "%.15" /end MEASUREMENT
/begin MEASUREMENT pDgrdHostDrvrErrRL "" SLONG eMdFltSts 0 0 -2147483648 2147483647 ECU_ADDRESS 0x70029798 FORMAT "%.15" /end MEASUREMENT
/begin MEASUREMENT pDgrdHostDrvrErrRR "" SLONG eMdFltSts 0 0 -2147483648 2147483647 ECU_ADDRESS 0x7002979c FORMAT "%.15" /end MEASUREMENT
/begin MEASUREMENT pDgrdActrUnknown "" SLONG eMdFltSts 0 0 -2147483648 2147483647 ECU_ADDRESS 0x700297a0 FORMAT "%.15" /end MEASUREMENT
/begin MEASUREMENT pDgrdMotStuck2RL "" SLONG eMdFltSts 0 0 -2147483648 2147483647 ECU_ADDRESS 0x700297a4 FORMAT "%.15" /end MEASUREMENT
/begin MEASUREMENT pDgrdMotStuck2RR "" SLONG eMdFltSts 0 0 -2147483648 2147483647 ECU_ADDRESS 0x700297a8 FORMAT "%.15" /end MEASUREMENT
/begin MEASUREMENT pDgrdMotStuck3RL "" SLONG eMdFltSts 0 0 -2147483648 2147483647 ECU_ADDRESS 0x700297ac FORMAT "%.15" /end MEASUREMENT
/begin MEASUREMENT pDgrdMotStuck3RR "" SLONG eMdFltSts 0 0 -2147483648 2147483647 ECU_ADDRESS 0x700297b0 FORMAT "%.15" /end MEASUREMENT
/begin MEASUREMENT pDgrdEnumUndefd "" SLONG eMdFltSts 0 0 -2147483648 2147483647 ECU_ADDRESS 0x700297b4 FORMAT "%.15" /end MEASUREMENT
/begin MEASUREMENT pCtrlMotEngmt "" SLONG eMdActrEngd 0 0 -2147483648 2147483647 ECU_ADDRESS 0x700297b8 FORMAT "%.15" /end MEASUREMENT
/begin MEASUREMENT pCtrlMotDisEngmt "" SLONG eMdActrEngd 0 0 -2147483648 2147483647 ECU_ADDRESS 0x700297bc FORMAT "%.15" /end MEASUREMENT
/begin MEASUREMENT pQualOneTiRels "" SLONG eMdActrEngd 0 0 -2147483648 2147483647 ECU_ADDRESS 0x700297c0 FORMAT "%.15" /end MEASUREMENT
/begin MEASUREMENT pCtrlPbcMod "" SLONG eMdCtrlMod 0 0 -2147483648 2147483647 ECU_ADDRESS 0x700297c4 FORMAT "%.15" /end MEASUREMENT
/begin MEASUREMENT pActtnMotStatRL "" SLONG eMdMotActtn 0 0 -2147483648 2147483647 ECU_ADDRESS 0x700297c8 FORMAT "%.15" /end MEASUREMENT
/begin MEASUREMENT pActtnMotStatRR "" SLONG eMdMotActtn 0 0 -2147483648 2147483647 ECU_ADDRESS 0x700297cc FORMAT "%.15" /end MEASUREMENT
/begin MEASUREMENT pTrigApplyRelsReq "" SLONG eMdTrigSwt 0 0 -2147483648 2147483647 ECU_ADDRESS 0x700297d0 FORMAT "%.15" /end MEASUREMENT
/begin MEASUREMENT pTrigDiagReq "" SLONG eMdTrigDiag 0 0 -2147483648 2147483647 ECU_ADDRESS 0x700297d4 FORMAT "%.15" /end MEASUREMENT
/begin MEASUREMENT pQualDiagOperMod "" SLONG eMdDiagOperMod 0 0 -2147483648 2147483647 ECU_ADDRESS 0x700297d8 FORMAT "%.15" /end MEASUREMENT
/begin MEASUREMENT pEngdOperCntrMEN "" UBYTE NO_COMPU_METHOD 0 0 0 255 ECU_ADDRESS 0x700297dc FORMAT "%.15" /end MEASUREMENT
/begin MEASUREMENT pEngdOperCntrPAD "" UBYTE NO_COMPU_METHOD 0 0 0 255 ECU_ADDRESS 0x700297dd FORMAT "%.15" /end MEASUREMENT
/begin MEASUREMENT pEngdOperCntrDYA "" UBYTE NO_COMPU_METHOD 0 0 0 255 ECU_ADDRESS 0x700297de FORMAT "%.15" /end MEASUREMENT
/begin MEASUREMENT pEngdOperCntrRBA "" UBYTE NO_COMPU_METHOD 0 0 0 255 ECU_ADDRESS 0x700297df FORMAT "%.15" /end MEASUREMENT
/begin MEASUREMENT pEngdOperCntrBPU "" UBYTE NO_COMPU_METHOD 0 0 0 255 ECU_ADDRESS 0x700297e0 FORMAT "%.15" /end MEASUREMENT
/begin MEASUREMENT pLogdOperCntrASM "" UBYTE NO_COMPU_METHOD 0 0 0 255 ECU_ADDRESS 0x700297e1 FORMAT "%.15" /end MEASUREMENT
/begin MEASUREMENT pLogdOperCntrDYA "" UBYTE NO_COMPU_METHOD 0 0 0 255 ECU_ADDRESS 0x700297e2 FORMAT "%.15" /end MEASUREMENT
/begin MEASUREMENT pLogdOperCntrMEN "" UBYTE NO_COMPU_METHOD 0 0 0 255 ECU_ADDRESS 0x700297e3 FORMAT "%.15" /end MEASUREMENT
/begin MEASUREMENT pLogdOperCntrPAD "" UBYTE NO_COMPU_METHOD 0 0 0 255 ECU_ADDRESS 0x700297e4 FORMAT "%.15" /end MEASUREMENT
/begin MEASUREMENT pLogdOperCntrRARTmp "" UBYTE NO_COMPU_METHOD 0 0 0 255 ECU_ADDRESS 0x700297e5 FORMAT "%.15" /end MEASUREMENT
/begin MEASUREMENT pLogdOperCntrRBA "" UBYTE NO_COMPU_METHOD 0 0 0 255 ECU_ADDRESS 0x700297e6 FORMAT "%.15" /end MEASUREMENT
/begin MEASUREMENT pLogdOperCntrBPU "" UBYTE NO_COMPU_METHOD 0 0 0 255 ECU_ADDRESS 0x700297e7 FORMAT "%.15" /end MEASUREMENT
/begin MEASUREMENT pActtnMotDynTarIRL "" SWORD NO_COMPU_METHOD 0 0 -32768 32767 ECU_ADDRESS 0x700297e8 FORMAT "%.15" /end MEASUREMENT
/begin MEASUREMENT pActtnMotDynTarIRR "" SWORD NO_COMPU_METHOD 0 0 -32768 32767 ECU_ADDRESS 0x700297ea FORMAT "%.15" /end MEASUREMENT
/begin MEASUREMENT pActtnMotStatTarIRL "" SWORD NO_COMPU_METHOD 0 0 -32768 32767 ECU_ADDRESS 0x700297ec FORMAT "%.15" /end MEASUREMENT
/begin MEASUREMENT pActtnMotStatTarIRR "" SWORD NO_COMPU_METHOD 0 0 -32768 32767 ECU_ADDRESS 0x700297ee FORMAT "%.15" /end MEASUREMENT
/begin MEASUREMENT pEngdDscTRL "" SWORD NO_COMPU_METHOD 0 0 -32768 32767 ECU_ADDRESS 0x700297f0 FORMAT "%.15" /end MEASUREMENT
/begin MEASUREMENT pEngdDscTRR "" SWORD NO_COMPU_METHOD 0 0 -32768 32767 ECU_ADDRESS 0x700297f2 FORMAT "%.15" /end MEASUREMENT
/begin MEASUREMENT pEngdHillGrdt "" SWORD NO_COMPU_METHOD 0 0 -32768 32767 ECU_ADDRESS 0x700297f4 FORMAT "%.15" /end MEASUREMENT
/begin MEASUREMENT pEngdPwrSplyU "" SWORD NO_COMPU_METHOD 0 0 -32768 32767 ECU_ADDRESS 0x700297f6 FORMAT "%.15" /end MEASUREMENT
/begin MEASUREMENT pEngdSpndlCntPosnRL "" SWORD NO_COMPU_METHOD 0 0 -32768 32767 ECU_ADDRESS 0x700297f8 FORMAT "%.15" /end MEASUREMENT
/begin MEASUREMENT pEngdSpndlCntPosnRR "" SWORD NO_COMPU_METHOD 0 0 -32768 32767 ECU_ADDRESS 0x700297fa FORMAT "%.15" /end MEASUREMENT
/begin MEASUREMENT pActvdHillGrdt "" SWORD NO_COMPU_METHOD 0 0 -32768 32767 ECU_ADDRESS 0x700297fc FORMAT "%.15" /end MEASUREMENT
/begin MEASUREMENT pActvdWhlDecelRL "" SWORD NO_COMPU_METHOD 0 0 -32768 32767 ECU_ADDRESS 0x700297fe FORMAT "%.15" /end MEASUREMENT
/begin MEASUREMENT pActvdWhlDecelRR "" SWORD NO_COMPU_METHOD 0 0 -32768 32767 ECU_ADDRESS 0x70029800 FORMAT "%.15" /end MEASUREMENT
/begin MEASUREMENT pActvdWhlSlipEstmnRL "" SWORD NO_COMPU_METHOD 0 0 -32768 32767 ECU_ADDRESS 0x70029802 FORMAT "%.15" /end MEASUREMENT
/begin MEASUREMENT pActvdWhlSlipEstmnRR "" SWORD NO_COMPU_METHOD 0 0 -32768 32767 ECU_ADDRESS 0x70029804 FORMAT "%.15" /end MEASUREMENT
/begin MEASUREMENT pActvdWhlSlipRL "" SWORD NO_COMPU_METHOD 0 0 -32768 32767 ECU_ADDRESS 0x70029806 FORMAT "%.15" /end MEASUREMENT
/begin MEASUREMENT pActvdWhlSlipRR "" SWORD NO_COMPU_METHOD 0 0 -32768 32767 ECU_ADDRESS 0x70029808 FORMAT "%.15" /end MEASUREMENT
/begin MEASUREMENT pActvdWhlSpdFL "" SWORD NO_COMPU_METHOD 0 0 -32768 32767 ECU_ADDRESS 0x7002980a FORMAT "%.15" /end MEASUREMENT
/begin MEASUREMENT pActvdWhlSpdFR "" SWORD NO_COMPU_METHOD 0 0 -32768 32767 ECU_ADDRESS 0x7002980c FORMAT "%.15" /end MEASUREMENT
/begin MEASUREMENT pLogdDscTRL "" SWORD NO_COMPU_METHOD 0 0 -32768 32767 ECU_ADDRESS 0x7002980e FORMAT "%.15" /end MEASUREMENT
/begin MEASUREMENT pLogdDscTRR "" SWORD NO_COMPU_METHOD 0 0 -32768 32767 ECU_ADDRESS 0x70029810 FORMAT "%.15" /end MEASUREMENT
/begin MEASUREMENT pActtnMotDynTarTiRL "" UWORD NO_COMPU_METHOD 0 0 0 65535 ECU_ADDRESS 0x70029812 FORMAT "%.15" /end MEASUREMENT
/begin MEASUREMENT pActtnMotDynTarTiRR "" UWORD NO_COMPU_METHOD 0 0 0 65535 ECU_ADDRESS 0x70029814 FORMAT "%.15" /end MEASUREMENT
/begin MEASUREMENT pActtnMotStatTarTiRL "" UWORD NO_COMPU_METHOD 0 0 0 65535 ECU_ADDRESS 0x70029816 FORMAT "%.15" /end MEASUREMENT
/begin MEASUREMENT pActtnMotStatTarTiRR "" UWORD NO_COMPU_METHOD 0 0 0 65535 ECU_ADDRESS 0x70029818 FORMAT "%.15" /end MEASUREMENT
/begin MEASUREMENT pEngdOperCntrRAR "" UWORD NO_COMPU_METHOD 0 0 0 65535 ECU_ADDRESS 0x7002981a FORMAT "%.15" /end MEASUREMENT
/begin MEASUREMENT pEngdOperCntrHTR "" UWORD NO_COMPU_METHOD 0 0 0 65535 ECU_ADDRESS 0x7002981c FORMAT "%.15" /end MEASUREMENT
/begin MEASUREMENT pActvdWhlPRL "" UWORD NO_COMPU_METHOD 0 0 0 65535 ECU_ADDRESS 0x7002981e FORMAT "%.15" /end MEASUREMENT
/begin MEASUREMENT pActvdWhlPRR "" UWORD NO_COMPU_METHOD 0 0 0 65535 ECU_ADDRESS 0x70029820 FORMAT "%.15" /end MEASUREMENT
/begin MEASUREMENT pActvdWhlPlsFL "" UWORD NO_COMPU_METHOD 0 0 0 65535 ECU_ADDRESS 0x70029822 FORMAT "%.15" /end MEASUREMENT
/begin MEASUREMENT pActvdWhlPlsFR "" UWORD NO_COMPU_METHOD 0 0 0 65535 ECU_ADDRESS 0x70029824 FORMAT "%.15" /end MEASUREMENT
/begin MEASUREMENT pActvdWhlPlsRL "" UWORD NO_COMPU_METHOD 0 0 0 65535 ECU_ADDRESS 0x70029826 FORMAT "%.15" /end MEASUREMENT
/begin MEASUREMENT pActvdWhlPlsRR "" UWORD NO_COMPU_METHOD 0 0 0 65535 ECU_ADDRESS 0x70029828 FORMAT "%.15" /end MEASUREMENT
/begin MEASUREMENT pLogdOperCntrHTR "" UWORD NO_COMPU_METHOD 0 0 0 65535 ECU_ADDRESS 0x7002982a FORMAT "%.15" /end MEASUREMENT
/begin MEASUREMENT pLogdOperCntrRAR "" UWORD NO_COMPU_METHOD 0 0 0 65535 ECU_ADDRESS 0x7002982c FORMAT "%.15" /end MEASUREMENT
/begin MEASUREMENT pLogdClmpFRL "" UWORD NO_COMPU_METHOD 0 0 0 65535 ECU_ADDRESS 0x7002982e FORMAT "%.15" /end MEASUREMENT
/begin MEASUREMENT pLogdClmpFRR "" UWORD NO_COMPU_METHOD 0 0 0 65535 ECU_ADDRESS 0x70029830 FORMAT "%.15" /end MEASUREMENT
/begin MEASUREMENT pEngdWhlPRL "" UWORD NO_COMPU_METHOD 0 0 0 65535 ECU_ADDRESS 0x70029832 FORMAT "%.15" /end MEASUREMENT
/begin MEASUREMENT pWarnPadAdjmtReq "" SLONG eMdOperActvn 0 0 -2147483648 2147483647 ECU_ADDRESS 0x70029834 FORMAT "%.15" /end MEASUREMENT
/begin MEASUREMENT pTrigReclmpPost "" SLONG eMdOperActvn 0 0 -2147483648 2147483647 ECU_ADDRESS 0x70029838 FORMAT "%.15" /end MEASUREMENT
/begin MEASUREMENT pTrigReclmpPre "" SLONG eMdOperActvn 0 0 -2147483648 2147483647 ECU_ADDRESS 0x7002983c FORMAT "%.15" /end MEASUREMENT
/begin MEASUREMENT pEngdErrPadAdjmt "" SLONG eMdOperActvn 0 0 -2147483648 2147483647 ECU_ADDRESS 0x70029840 FORMAT "%.15" /end MEASUREMENT
/begin MEASUREMENT pReqStsDyn "" SLONG eMdCtrl 0 0 -2147483648 2147483647 ECU_ADDRESS 0x70029844 FORMAT "%.15" /end MEASUREMENT
/begin MEASUREMENT pReqStsStat "" SLONG eMdCtrl 0 0 -2147483648 2147483647 ECU_ADDRESS 0x70029848 FORMAT "%.15" /end MEASUREMENT
/begin MEASUREMENT pCtrlDyn "" SLONG eMdCtrl 0 0 -2147483648 2147483647 ECU_ADDRESS 0x7002984c FORMAT "%.15" /end MEASUREMENT
/begin MEASUREMENT pEngdEpbReq "" SLONG eMdCtrl 0 0 -2147483648 2147483647 ECU_ADDRESS 0x70029850 FORMAT "%.15" /end MEASUREMENT
/begin MEASUREMENT pCtrlStat "" SLONG eMdCtrl 0 0 -2147483648 2147483647 ECU_ADDRESS 0x70029854 FORMAT "%.15" /end MEASUREMENT
/begin MEASUREMENT pEngdMot "" SLONG eMdActrEngd 0 0 -2147483648 2147483647 ECU_ADDRESS 0x70029858 FORMAT "%.15" /end MEASUREMENT
/begin MEASUREMENT pQualActrStVldty "" SLONG eMdActrEngd 0 0 -2147483648 2147483647 ECU_ADDRESS 0x7002985c FORMAT "%.15" /end MEASUREMENT
/begin MEASUREMENT pEngdStgrSide "" SLONG eMdActrEngd 0 0 -2147483648 2147483647 ECU_ADDRESS 0x70029860 FORMAT "%.15" /end MEASUREMENT
/begin MEASUREMENT pActvtdActrStIntRR "" SLONG eMdActrStInt 0 0 -2147483648 2147483647 ECU_ADDRESS 0x70029864 FORMAT "%.15" /end MEASUREMENT
/begin MEASUREMENT pActvtdActrStIntRL "" SLONG eMdActrStInt 0 0 -2147483648 2147483647 ECU_ADDRESS 0x70029868 FORMAT "%.15" /end MEASUREMENT
/begin MEASUREMENT pLogdActrStIntRL "" SLONG eMdActrStInt 0 0 -2147483648 2147483647 ECU_ADDRESS 0x7002986c FORMAT "%.15" /end MEASUREMENT
/begin MEASUREMENT pLogdActrStIntRR "" SLONG eMdActrStInt 0 0 -2147483648 2147483647 ECU_ADDRESS 0x70029870 FORMAT "%.15" /end MEASUREMENT
/begin MEASUREMENT pActtnMotDynRL "" SLONG eMdMotActtn 0 0 -2147483648 2147483647 ECU_ADDRESS 0x70029874 FORMAT "%.15" /end MEASUREMENT
/begin MEASUREMENT pActtnMotDynRR "" SLONG eMdMotActtn 0 0 -2147483648 2147483647 ECU_ADDRESS 0x70029878 FORMAT "%.15" /end MEASUREMENT
/begin MEASUREMENT pActtnMotEmgyRL "" SLONG eMdMotActtn 0 0 -2147483648 2147483647 ECU_ADDRESS 0x7002987c FORMAT "%.15" /end MEASUREMENT
/begin MEASUREMENT pActtnMotEmgyRR "" SLONG eMdMotActtn 0 0 -2147483648 2147483647 ECU_ADDRESS 0x70029880 FORMAT "%.15" /end MEASUREMENT
/begin MEASUREMENT pCtrlStsDyn "" SLONG eMdCtrlSts 0 0 -2147483648 2147483647 ECU_ADDRESS 0x70029884 FORMAT "%.15" /end MEASUREMENT
/begin MEASUREMENT pCtrlStsStat "" SLONG eMdCtrlSts 0 0 -2147483648 2147483647 ECU_ADDRESS 0x70029888 FORMAT "%.15" /end MEASUREMENT
/begin MEASUREMENT pActvdOperEpb "" SLONG eMdCntrActtn 0 0 -2147483648 2147483647 ECU_ADDRESS 0x7002988c FORMAT "%.15" /end MEASUREMENT
/begin MEASUREMENT pEngdRngDscTRL "" SLONG eMdCmp 0 0 -2147483648 2147483647 ECU_ADDRESS 0x70029890 FORMAT "%.15" /end MEASUREMENT
/begin MEASUREMENT pEngdRngDscTRR "" SLONG eMdCmp 0 0 -2147483648 2147483647 ECU_ADDRESS 0x70029894 FORMAT "%.15" /end MEASUREMENT
/begin MEASUREMENT pEngdRngHillGrdt "" SLONG eMdCmp 0 0 -2147483648 2147483647 ECU_ADDRESS 0x70029898 FORMAT "%.15" /end MEASUREMENT
/begin MEASUREMENT pEngdRngPwrSplyU "" SLONG eMdCmp 0 0 -2147483648 2147483647 ECU_ADDRESS 0x7002989c FORMAT "%.15" /end MEASUREMENT
/begin MEASUREMENT pEngdRngWhlP "" SLONG eMdCmp 0 0 -2147483648 2147483647 ECU_ADDRESS 0x700298a0 FORMAT "%.15" /end MEASUREMENT
/begin MEASUREMENT pEngdErrReclmp "" SLONG eMdReclmp 0 0 -2147483648 2147483647 ECU_ADDRESS 0x700298a4 FORMAT "%.15" /end MEASUREMENT
/begin MEASUREMENT pEngdErrReclmpExcd "" SLONG eMdSigErr 0 0 -2147483648 2147483647 ECU_ADDRESS 0x700298a8 FORMAT "%.15" /end MEASUREMENT
/begin MEASUREMENT pEngdErrMotDrvrErrRR "" SLONG eMdDrvrSnsr 0 0 -2147483648 2147483647 ECU_ADDRESS 0x700298ac FORMAT "%.15" /end MEASUREMENT
/begin MEASUREMENT pEngdErrMotOvloadRR "" SLONG eMdDrvrSnsr 0 0 -2147483648 2147483647 ECU_ADDRESS 0x700298b0 FORMAT "%.15" /end MEASUREMENT
/begin MEASUREMENT pEngdErrMotOvrunRR "" SLONG eMdDrvrSnsr 0 0 -2147483648 2147483647 ECU_ADDRESS 0x700298b4 FORMAT "%.15" /end MEASUREMENT
/begin MEASUREMENT pEngdErrMotStuck1RR "" SLONG eMdDrvrSnsr 0 0 -2147483648 2147483647 ECU_ADDRESS 0x700298b8 FORMAT "%.15" /end MEASUREMENT
/begin MEASUREMENT pEngdErrMotStuck2RR "" SLONG eMdDrvrSnsr 0 0 -2147483648 2147483647 ECU_ADDRESS 0x700298bc FORMAT "%.15" /end MEASUREMENT
/begin MEASUREMENT pEngdErrMotStuck3RR "" SLONG eMdDrvrSnsr 0 0 -2147483648 2147483647 ECU_ADDRESS 0x700298c0 FORMAT "%.15" /end MEASUREMENT
/begin MEASUREMENT pEngdErrMotDrvrErrRL "" SLONG eMdDrvrSnsr 0 0 -2147483648 2147483647 ECU_ADDRESS 0x700298c4 FORMAT "%.15" /end MEASUREMENT
/begin MEASUREMENT pEngdErrMotOvloadRL "" SLONG eMdDrvrSnsr 0 0 -2147483648 2147483647 ECU_ADDRESS 0x700298c8 FORMAT "%.15" /end MEASUREMENT
/begin MEASUREMENT pEngdErrMotOvrunRL "" SLONG eMdDrvrSnsr 0 0 -2147483648 2147483647 ECU_ADDRESS 0x700298cc FORMAT "%.15" /end MEASUREMENT
/begin MEASUREMENT pEngdErrMotStuck1RL "" SLONG eMdDrvrSnsr 0 0 -2147483648 2147483647 ECU_ADDRESS 0x700298d0 FORMAT "%.15" /end MEASUREMENT
/begin MEASUREMENT pEngdErrMotStuck2RL "" SLONG eMdDrvrSnsr 0 0 -2147483648 2147483647 ECU_ADDRESS 0x700298d4 FORMAT "%.15" /end MEASUREMENT
/begin MEASUREMENT pEngdErrMotStuck3RL "" SLONG eMdDrvrSnsr 0 0 -2147483648 2147483647 ECU_ADDRESS 0x700298d8 FORMAT "%.15" /end MEASUREMENT
/begin MEASUREMENT pWarnPwrLtchReq "" SLONG eMdLatchActvn 0 0 -2147483648 2147483647 ECU_ADDRESS 0x700298dc FORMAT "%.15" /end MEASUREMENT
/begin MEASUREMENT pQualReqVldty "" SLONG eMdReqQual 0 0 -2147483648 2147483647 ECU_ADDRESS 0x700298e0 FORMAT "%.15" /end MEASUREMENT
/begin MEASUREMENT pSwtOvrdAvlty "" SLONG eMdOvrdAvlty 0 0 -2147483648 2147483647 ECU_ADDRESS 0x700298e4 FORMAT "%.15" /end MEASUREMENT
/begin MEASUREMENT pEngdActrStExtRL "" SLONG eMdActrStExt 0 0 -2147483648 2147483647 ECU_ADDRESS 0x700298e8 FORMAT "%.15" /end MEASUREMENT
/begin MEASUREMENT pEngdActrStExtRR "" SLONG eMdActrStExt 0 0 -2147483648 2147483647 ECU_ADDRESS 0x700298ec FORMAT "%.15" /end MEASUREMENT
/begin MEASUREMENT pEngdWhlPRR "" UWORD NO_COMPU_METHOD 0 0 0 65535 ECU_ADDRESS 0x700298f0 FORMAT "%.15" /end MEASUREMENT
/begin MEASUREMENT pDrvrHpsTarP "" UWORD NO_COMPU_METHOD 0 0 0 65535 ECU_ADDRESS 0x700298f2 FORMAT "%.15" /end MEASUREMENT
/begin MEASUREMENT pQualStorg "" SLONG eMdStorgQual 0 0 -2147483648 2147483647 ECU_ADDRESS 0x700298f4 FORMAT "%.15" /end MEASUREMENT
/begin MEASUREMENT pAckDiagReq "" SLONG eMdTrigDiag 0 0 -2147483648 2147483647 ECU_ADDRESS 0x700298f8 FORMAT "%.15" /end MEASUREMENT
/begin MEASUREMENT pDrvrMotCmdRR "" SLONG NO_COMPU_METHOD 0 0 -2147483648 2147483647 ECU_ADDRESS 0x700298fc FORMAT "%.15" /end MEASUREMENT
/begin MEASUREMENT pPbcDevMsg "" SLONG NO_COMPU_METHOD 0 0 -2147483648 2147483647 ECU_ADDRESS 0x70029900 FORMAT "%.15" /end MEASUREMENT
/begin MEASUREMENT pSnsrDynWhlPlsFL "" UBYTE NO_COMPU_METHOD 0 0 0 255 ECU_ADDRESS 0x70029902 FORMAT "%.15" /end MEASUREMENT
/begin CHARACTERISTIC Cal_I_CmpU_Sply0 "" VALUE 0x70029f6c __UWORD_S 0 NO_COMPU_METHOD -2147483648 2147483647 FORMAT "%.15" /end CHARACTERISTIC
/begin CHARACTERISTIC Cal_I_CmpU_Sply1 "" VALUE 0x70029f6e __UWORD_S 0 NO_COMPU_METHOD -2147483648 2147483647 FORMAT "%.15" /end CHARACTERISTIC
/begin CHARACTERISTIC Cal_I_CmpU_Sply2 "" VALUE 0x70029f70 __UWORD_S 0 NO_COMPU_METHOD -2147483648 2147483647 FORMAT "%.15" /end CHARACTERISTIC
/begin CHARACTERISTIC Cal_I_CmpU_Sply3 "" VALUE 0x70029f72 __UWORD_S 0 NO_COMPU_METHOD -2147483648 2147483647 FORMAT "%.15" /end CHARACTERISTIC
/begin CHARACTERISTIC Cal_I_CmpU_Sply4 "" VALUE 0x70029f74 __UWORD_S 0 NO_COMPU_METHOD -2147483648 2147483647 FORMAT "%.15" /end CHARACTERISTIC
/begin CHARACTERISTIC Cal_I_CmpU_Sply5 "" VALUE 0x70029f76 __UWORD_S 0 NO_COMPU_METHOD -2147483648 2147483647 FORMAT "%.15" /end CHARACTERISTIC
/begin CHARACTERISTIC Cal_I_CmpU_Sply6 "" VALUE 0x70029f78 __UWORD_S 0 NO_COMPU_METHOD -2147483648 2147483647 FORMAT "%.15" /end CHARACTERISTIC
/begin CHARACTERISTIC Cal_Spd_Dyn_Lo_Spd "" VALUE 0x70029f7a __UWORD_S 0 NO_COMPU_METHOD -2147483648 2147483647 FORMAT "%.15" /end CHARACTERISTIC
/begin CHARACTERISTIC Cal_Ti_CmpU_Sply3 "" VALUE 0x70029f7c __UWORD_S 0 NO_COMPU_METHOD -2147483648 2147483647 FORMAT "%.15" /end CHARACTERISTIC
/begin CHARACTERISTIC Cal_Ti_CmpU_Sply4 "" VALUE 0x70029f7e __UWORD_S 0 NO_COMPU_METHOD -2147483648 2147483647 FORMAT "%.15" /end CHARACTERISTIC
/begin CHARACTERISTIC Cal_Ti_Posn_Cnt_Tar_Dyn_Dgrd1 "" VALUE 0x70029f80 __UWORD_S 0 NO_COMPU_METHOD -2147483648 2147483647 FORMAT "%.15" /end CHARACTERISTIC
/begin CHARACTERISTIC Cal_Ti_Posn_Cnt_TchBrkd "" VALUE 0x70029f82 __UWORD_S 0 NO_COMPU_METHOD -2147483648 2147483647 FORMAT "%.15" /end CHARACTERISTIC
